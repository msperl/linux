## Documentation/devicetree/bindings/net/can/microchip,mcp2517fd.txt
```
* Microchip MCP2517 stand-alone CAN controller device tree bindings

Required properties:
 - compatible: Should be one of the following:
   - "microchip,mcp2517fd" for MCP2517fd.
 - reg: SPI chip select.
 - clocks: The clock feeding the CAN controller.
 - interrupt-parent: The parent interrupt controller.
 - interrupts: Should contain IRQ line for the CAN controller.
 - gpio-controller : Indicates this device is a GPIO controller.
 - #gpio-cells : Should be two. The first cell is the pin number and the
		 second cell is used to specify optional parameters
		 (currently unused).

Optional properties:
 - vdd-supply: Regulator that powers the CAN controller.
 - xceiver-supply: Regulator that powers the CAN transceiver.
 - microchip,clock-out-div = <0|1|2|4|10>: Clock output pin divider
   			     		   0 = Start of Frame output
					   default: 10
 - microchip,clock-div: divide the internal clock divider by 2
 - gpio-open-drain: put int, gpio0, gpio1 in open-drain mode
   		    instead of default push-pull

Example:
	can0: can@0 {
		compatible = "microchip,mcp2515";
		reg = <0>;
		clocks = <&clk24m>;
		interrupt-parent = <&gpio4>;
		interrupts = <13 0x8>;
		vdd-supply = <&reg5v0>;
		xceiver-supply = <&reg5v0>;
		gpio-controller;
                #gpio-cells = <2>;
	};
```

## drivers/net/can/spi/Kconfig
```kconfig
menu "CAN SPI interfaces"
	depends on SPI

config CAN_MCP251X
	tristate "Microchip MCP251x SPI CAN controllers"
	depends on HAS_DMA
	---help---
	  Driver for the Microchip MCP251x SPI CAN controllers.

config CAN_MCP2517FD
	tristate "Microchip MCP2517FD SPI CAN controllers"
	depends on HAS_DMA
	---help---
	  Driver for the Microchip MCP2517FD SPI CAN controllers.

endmenu
```
